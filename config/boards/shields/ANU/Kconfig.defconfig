## config/boards/shields/ANU/Kconfig.defconfig
```kconfig
# Copyright (c) 2020 The ZMK Contributors
# SPDX-License-Identifier: MIT

if SHIELD_ANU_LEFT

config ZMK_KEYBOARD_NAME
    default "ANU"

endif
```

## config/boards/shields/ANU/Kconfig.shield
```kconfig
 #
 # Copyright (c) 2020 The ZMK Contributors
 #
 # SPDX-License-Identifier: MIT
 #

config ANU
def_bool $(shields_list_contains,anu)
```
